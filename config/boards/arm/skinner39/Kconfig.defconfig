## config/boards/arm/skinner39/Kconfig.defconfig
```kconfig
# Copyright (c) 2020 The ZMK Contributors
# SPDX-License-Identifier: MIT

# 2026-10-28: central を右（トラックボール側・Seaside39 と同じ）に変更。変えるのは central 役だけ
# （v0.3・badjeff ドライバ・SLEEP=n・PHY_2M=n はそのまま）。トラックボールは右でローカル処理（BLE relay なし）。
# 履歴: 2026-06-12 に左central に戻した（6月は v0.3化・ドライバ・central を同時に変えたので原因未切り分け）。
if BOARD_SKINNER39_RIGHT

config ZMK_KEYBOARD_NAME
	default "SKINNER39"

config ZMK_SPLIT_ROLE_CENTRAL
	default y

endif # BOARD_SKINNER39_RIGHT

if BOARD_SKINNER39_LEFT || BOARD_SKINNER39_RIGHT

config ZMK_SPLIT
	default y

config BT_CTLR
	default BT

if USB

config USB_NRFX
	default y

config USB_DEVICE_STACK
	default y

endif # USB

if LVGL

config ZMK_DISPLAY_DEDICATED_THREAD_STACK_SIZE
	default 8192

config LV_Z_VDB_SIZE
	default 64

config LV_DPI_DEF
	default 148

config LV_Z_BITS_PER_PIXEL
	default 1

choice LV_COLOR_DEPTH
	default LV_COLOR_DEPTH_1
endchoice

endif # LVGL

config I2C
	default y

config SPI
	default y

endif # BOARD_SKINNER39_LEFT || BOARD_SKINNER39_RIGHT
```

## config/modules/zmk-input-processor-gesture/Kconfig
```kconfig
# SPDX-License-Identifier: MIT

if INPUT

config ZMK_INPUT_PROCESSOR_GESTURE
    bool "Gesture input processor (flick trackball to send a keypress)"
    default y
    depends on DT_HAS_ZMK_INPUT_PROCESSOR_GESTURE_ENABLED

endif
```

## config/modules/zmk-input-processor-gesture/dts/bindings/input_processors/zmk,input-processor-gesture.yaml
```yaml
# SPDX-License-Identifier: MIT
#
# ボールを一方向に一定距離「弾く」動作を検知し、負方向/正方向それぞれに割り当てた
# キー動作(bindings)を1回だけ送る入力プロセッサ。
# 1インスタンスにつき片方の軸(X or Y)だけを見る。上下左右をカバーするには
# X軸用・Y軸用の2インスタンスを用意して、同じinput-listenerのinput-processorsに並べる。
#
# 例:
#   zip_gesture_x: zip_gesture_x {
#       compatible = "zmk,input-processor-gesture";
#       #input-processor-cells = <0>;
#       type = <INPUT_EV_REL>;
#       code = <INPUT_REL_X>;
#       threshold = <40>;
#       bindings = <&kp C_LEFT>, <&kp C_RIGHT>;  // [0]=負方向(左) [1]=正方向(右)
#   };

description: |
  Detects a flick gesture (accumulated relative movement past a threshold) on a single
  input axis and invokes one of two bound behaviors depending on direction.

compatible: "zmk,input-processor-gesture"

include: ip_zero_param.yaml

properties:
  type:
    type: int
    description: 監視するイベントタイプ（省略時はINPUT_EV_REL=2）
  code:
    type: int
    required: true
    description: 監視する軸のコード（例 INPUT_REL_X=0 / INPUT_REL_Y=1）
  threshold:
    type: int
    default: 40
    description: 累積移動量がこの値を超えたらbindingsを発火してリセットする
  bindings:
    type: phandle-array
    required: true
    description: 必ず2つ。[0]=負方向で送る動作、[1]=正方向で送る動作
```
