## boards/arm/skinner39/Kconfig.defconfig
```kconfig
# Copyright (c) 2020 The ZMK Contributors
# SPDX-License-Identifier: MIT

if BOARD_SKINNER39_LEFT

config ZMK_KEYBOARD_NAME
	default "SKINNER39"

config ZMK_SPLIT_ROLE_CENTRAL
	default y

endif # BOARD_SKINNER39_LEFT

if BOARD_SKINNER39_LEFT || BOARD_SKINNER39_RIGHT

config ZMK_SPLIT
	default y

config BT_CTLR
	default BT

if USB

config USB_NRFX
	default y

config USB_DEVICE_STACK
	default y

endif # USB

config I2C
	default y

config SPI
	default y

endif # BOARD_SKINNER39_LEFT || BOARD_SKINNER39_RIGHT
```

## boards/arm/skinner39/skinner39_left_nrf52840_zmk_defconfig
```kconfig
# SPDX-License-Identifier: MIT

CONFIG_INPUT=y
CONFIG_ZMK_POINTING=y

CONFIG_LOG_PROCESS_THREAD_STARTUP_DELAY_MS=4000
CONFIG_ZMK_DISPLAY=y
CONFIG_SPI=y
CONFIG_SPI_NRFX=y
CONFIG_ARM_MPU=y

CONFIG_PINCTRL=y

CONFIG_GPIO=y

CONFIG_USE_DT_CODE_PARTITION=y
CONFIG_BUILD_OUTPUT_UF2=y

CONFIG_MPU_ALLOW_FLASH_WRITE=y
CONFIG_NVS=y
CONFIG_SETTINGS_NVS=y
CONFIG_FLASH=y
CONFIG_FLASH_PAGE_LAYOUT=y
CONFIG_FLASH_MAP=y

CONFIG_ZMK_USB=y
CONFIG_ZMK_BLE=y
CONFIG_ZMK_SLEEP=y

# 2026-06-05: PC側BTオフ→オン再接続時のフリーズ対策（候補1/Windows再接続安定化）
# 効かなければ戻して CONFIG_ZMK_BLE_EXPERIMENTAL_FEATURES=y を試す
CONFIG_BT_CTLR_PHY_2M=n

# 2026-06-10: ZMK #3195 対策の本命（central が deep sleep から wake しない問題）。
# 6/7 の「Studioなしビルド」は build.yaml の snippet を外しただけで、ここの
# CONFIG_ZMK_STUDIO=y が生きたままだった＝Studio本体(RPC/BLE transport)は有効のままで
# #3195 の回避策（CONFIG_ZMK_STUDIO=n）は実は未適用だった。今回明示的に無効化する。
# Studio を使う時は下2行を =y / =n に戻す（build.yaml の snippet 切り替えも忘れずに）
CONFIG_ZMK_STUDIO=n
# CONFIG_ZMK_STUDIO_LOCKING=n
```

## config/boards/arm/skinner39/Kconfig.skinner39_left
```kconfig
# SPDX-License-Identifier: MIT

config BOARD_SKINNER39_LEFT
	select SOC_NRF52840_QIAA
```

## config/boards/arm/skinner39/Kconfig.skinner39_right
```kconfig
# SPDX-License-Identifier: MIT

config BOARD_SKINNER39_RIGHT
	select SOC_NRF52840_QIAA
```

## config/boards/arm/skinner39/board.yml
```yaml
boards:
  - name: skinner39_left
    vendor: hoch1122
    socs:
      - name: nrf52840
        variants:
          - name: zmk
  - name: skinner39_right
    vendor: hoch1122
    socs:
      - name: nrf52840
        variants:
          - name: zmk
```

## config/boards/arm/skinner39/skinner39_left_defconfig
```kconfig
# SPDX-License-Identifier: MIT
CONFIG_INPUT=y
CONFIG_ZMK_MOUSE=y
CONFIG_PMW3610=y
CONFIG_PMW3610_INVERT_X=n
CONFIG_PMW3610_INVERT_Y=y
CONFIG_PMW3610_SMART_ALGORITHM=y

CONFIG_ZMK_EXT_POWER=y
CONFIG_SOC_SERIES_NRF52X=y
CONFIG_SOC_NRF52840_QIAA=y
CONFIG_BOARD_SKINNER39_LEFT=y

CONFIG_LOG_PROCESS_THREAD_STARTUP_DELAY_MS=4000
CONFIG_ZMK_DISPLAY=y
CONFIG_SPI=y
# Enable MPU
CONFIG_ARM_MPU=y

CONFIG_PINCTRL=y

CONFIG_GPIO=y

CONFIG_USE_DT_CODE_PARTITION=y
CONFIG_BUILD_OUTPUT_UF2=y

CONFIG_MPU_ALLOW_FLASH_WRITE=y
CONFIG_NVS=y
CONFIG_SETTINGS_NVS=y
CONFIG_FLASH=y
CONFIG_FLASH_PAGE_LAYOUT=y
CONFIG_FLASH_MAP=y

CONFIG_ZMK_USB=y
CONFIG_ZMK_BLE=y

# 2026-06-10: Windows再接続フリーズ対策（PHY 2M無効・実証済み）。v0.3系でも維持
CONFIG_BT_CTLR_PHY_2M=n

# 2026-06-10: ZMK Studio は使わない方針（#3195 対策。旧ファームの CONFIG_ZMK_STUDIO=y は削除）

CONFIG_EC11=y
CONFIG_EC11_TRIGGER_GLOBAL_THREAD=y
```

## config/west.yml
```yaml
manifest:
  remotes:
    - name: zmkfirmware
      url-base: https://github.com/zmkfirmware
    - name: badjeff
      url-base: https://github.com/badjeff
  projects:
    # 2026-06-10: Zephyr 4.1 regression（#3207/#3195: central deep sleep wake失敗）回避のため
    # v0.3 タグに固定（Seaside39 実機と同じ構成）。v0.4.0 リリース後に更新を検討
    - name: zmk
      remote: zmkfirmware
      revision: v0.3
      import: app/west.yml
    # 2026-06-12: inorichi 版は central 専用（レイヤー参照がperipheralでリンクエラー）のため
    # badjeff 上流（hoch1122 fork の親）を fork 時点のコミットにピン留め。
    # peripheral 対応・f9f611a 実証コードと同一・fork 管理不要。
    # 注意: badjeff の「pmw3610-alt」（別リポジトリ）は Zephyr 4.1 向けで、これとは別物
    - name: zmk-pmw3610-driver
      remote: badjeff
      revision: e3b4a7afe717a0614579ad4d44efaf3cd7a61434
  self:
    path: config
```
